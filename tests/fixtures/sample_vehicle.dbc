VERSION ""

NS_ :

BS_:

BU_: ECU

BO_ 291 VehicleStatus: 8 ECU
 SG_ VehicleSpeed : 0|16@1+ (0.1,0) [0|250] "km/h" ECU
 SG_ Gear : 16|8@1+ (1,0) [0|15] "" ECU

BO_ 512 BodyState: 8 ECU
 SG_ LightState : 0|8@1+ (1,0) [0|3] "" ECU
 SG_ BrakePressed : 8|1@1+ (1,0) [0|1] "" ECU

VAL_ 512 LightState 0 "Off" 1 "LowBeam" 2 "HighBeam" 3 "Hazard";
